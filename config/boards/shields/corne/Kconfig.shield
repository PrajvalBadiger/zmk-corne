## config/boards/shields/corne/Kconfig.shield
```kconfig
# Copyright (c) 2020 Pete Johanson
# SPDX-License-Identifier: MIT

if SHIELD_CORNE_LEFT || SHIELD_CORNE_RIGHT
config ZMK_KEYBOARD_NAME
    default "PRJ's keeb"
endif

config SHIELD_CORNE_LEFT
    def_bool $(shields_list_contains,corne_left)

config SHIELD_CORNE_RIGHT
    def_bool $(shields_list_contains,corne_right)
```
